#include <Keyboard.h>

/*
The code to run the Fight Stick.
*/

const int PinJoyDown = 2;  // Joystick Inputs
const int PinJoyUp = 3;
const int PinJoyRight = 4;
const int PinJoyLeft = 5;

const int PinLP = 6; //Top row/Punch buttons
const int PinMP = 7;
const int PinHP = 8;
const int PinPP = 9;

const int PinLK = 10; //Button Row/Kick buttons
const int PinMK = 11;
const int PinHK = 12;
const int PinKK = 13;


void setup() {
    //start serial connection
  Serial.begin(9600);
  //configure pin 2 as an input and enable the internal pull-up resistor
  pinMode(PinJoyUp, INPUT_PULLUP);
  pinMode(PinJoyDown, INPUT_PULLUP);
  pinMode(PinJoyLeft, INPUT_PULLUP);
  pinMode(PinJoyRight, INPUT_PULLUP);
  
  pinMode(PinLP, INPUT_PULLUP);
  pinMode(PinMP, INPUT_PULLUP);
  pinMode(PinHP, INPUT_PULLUP);
  pinMode(PinPP, INPUT_PULLUP);
  
  pinMode(PinLK, INPUT_PULLUP);
  pinMode(PinMK, INPUT_PULLUP);
  pinMode(PinHK, INPUT_PULLUP);
  pinMode(PinKK, INPUT_PULLUP);

  Keyboard.begin();
}

void loop() {
  
  //Joystick Below
  
  if (digitalRead(PinJoyUp) == LOW) {
    Keyboard.press(KEY_UP_ARROW);
  }
  else {
    Keyboard.release(KEY_UP_ARROW);
  }
  
  if (digitalRead(PinJoyDown) == LOW) {
    Keyboard.press(KEY_DOWN_ARROW);
  }
  else {
    Keyboard.release(KEY_DOWN_ARROW);
  }
  
  if (digitalRead(PinJoyLeft) == LOW) {
    Keyboard.press(KEY_LEFT_ARROW);
  }
  else {
    Keyboard.release(KEY_LEFT_ARROW);
  }
  
  if (digitalRead(PinJoyRight) == LOW) {
    Keyboard.press(KEY_RIGHT_ARROW);
  }
  else {
    Keyboard.release(KEY_RIGHT_ARROW);
  }
  
  
  // ***************** Top Row Below
  
  if (digitalRead(PinLP) == LOW) {
    Keyboard.press('h');
  }
  else {
    Keyboard.release('h');
  }
  
  if (digitalRead(PinMP) == LOW) {
    Keyboard.press('j');
  }
  else {
    Keyboard.release('j');
  }
  
  if (digitalRead(PinHP) == LOW) {
    Keyboard.press('k');
  }
  else {
    Keyboard.release('k');
  }
  
  if (digitalRead(PinPP) == LOW) {
    Keyboard.press('1');
  }
  else {
    Keyboard.release('1');
  }
  
  //****************** Bottom Row
  
  if (digitalRead(PinLK) == LOW) {
    Keyboard.press('b');
  }
  else {
    Keyboard.release('b');
  }
  
  if (digitalRead(PinMK) == LOW) {
    Keyboard.press('n');
  }
  else {
    Keyboard.release('n');
  }
  
  if (digitalRead(PinHK) == LOW) {
    Keyboard.press('m');
  }
  else {
    Keyboard.release('m');
  }
  
  if (digitalRead(PinKK) == LOW) {
    Keyboard.press('2');
  }
  else {
    Keyboard.release('2');
  }
  
  
  delay(1);
}
  
  
